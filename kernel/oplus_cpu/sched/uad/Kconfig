## kernel/oplus_cpu/sched/uad/Kconfig
```kconfig
config OPLUS_CPU_FREQ_GOV_UAG
	tristate "UAG CPU frequency policy governor"
	depends on CPU_FREQ && SMP
	select CPU_FREQ_GOV_ATTR_SET
	select IRQ_WORK
	help
	  Enable the OPlus UAG CPU frequency governor.
	  This minimal configuration builds the Qualcomm/WALT governor
	  without optional OPlus extensions such as Frame Boost, AMU,
	  target-load tables, nonlinear OPP control, touch boost,
	  soft limits, or the CPU ioctl interface.
```
